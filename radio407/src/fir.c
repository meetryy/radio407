#include "fir.h"
#include <stdio.h>
#include <stdint.h>

#include "global.h"
#include "audio_cfg.h"
//#include "math_helper.h"

CCM_RAM_STATIC
static float32_t firState1[AUDIO_BUFFER_LEN/2 + NUM_TAPS - 1];
CCM_RAM_STATIC
static float32_t firState2[AUDIO_BUFFER_LEN/2 + NUM_TAPS - 1];
arm_fir_instance_f32 S1;
arm_fir_instance_f32 S2;

void firInit(void) {
  arm_fir_init_f32(&S1, NUM_TAPS, firCoeffs32, firState1, AUDIO_BUFFER_LEN/2);
  arm_fir_init_f32(&S2, NUM_TAPS, firCoeffs32, firState2, AUDIO_BUFFER_LEN/2);
  return 0;
}

UART_HandleTypeDef huart1;

void firTest(float32_t  *inputF32, float32_t *outputF32, int blockSize, int i) {
  if (i==0)
	  arm_fir_f32(&S1, inputF32, outputF32, blockSize);
	  //convolve(&firCoeffs32, NUM_TAPS, &inputF32, &outputF32);

  if (i==1)
	  //convolve(&firCoeffs32, NUM_TAPS, &inputF32, &outputF32);
	 arm_fir_f32(&S2, inputF32, outputF32, blockSize);

  return 0;
}

void convolve (float *p_coeffs, float p_coeffs_n,
		float *p_in, float *p_out, float n)
{
  int i, j, k;
  double tmp;

  for (k = 0; k < n; k++)  //  position in output
  {
    tmp = 0;

    for (i = 0; i < p_coeffs_n; i++)  //  position in coefficients array
    {
      j = k - i;  //  position in input

      if (j >= 0)  //  bounds check for input buffer
      {
        tmp += p_coeffs [k] * p_in [j];
      }
    }

    p_out [i] = tmp;
  }
}



/*
double coeffs[FILTER_LEN] =
{
  -0.0448093,  0.0322875,   0.0181163,   0.0087615,   0.0056797,
   0.0086685,  0.0148049,   0.0187190,   0.0151019,   0.0027594,
  -0.0132676, -0.0232561,  -0.0187804,   0.0006382,   0.0250536,
   0.0387214,  0.0299817,   0.0002609,  -0.0345546,  -0.0525282,
  -0.0395620,  0.0000246,   0.0440998,   0.0651867,   0.0479110,
   0.0000135, -0.0508558,  -0.0736313,  -0.0529380,  -0.0000709,
   0.0540186,  0.0766746,   0.0540186,  -0.0000709,  -0.0529380,
  -0.0736313, -0.0508558,   0.0000135,   0.0479110,   0.0651867,
   0.0440998,  0.0000246,  -0.0395620,  -0.0525282,  -0.0345546,
   0.0002609,  0.0299817,   0.0387214,   0.0250536,   0.0006382,
  -0.0187804, -0.0232561,  -0.0132676,   0.0027594,   0.0151019,
   0.0187190,  0.0148049,   0.0086685,   0.0056797,   0.0087615,
   0.0181163,  0.0322875,  -0.0448093
};

// array to hold input samples
double insamp[ BUFFER_LEN ];

// FIR init
void firFloatInit( void )
{
    memset( insamp, 0, sizeof( insamp ) );
}

// the FIR filter function
void firFloat( double *coeffs, double *input, double *output,
       int length, int filterLength )
{
    double acc;     // accumulator for MACs
    double *coeffp; // pointer to coefficients
    double *inputp; // pointer to input samples
    int n;
    int k;

    // put the new samples at the high end of the buffer
    memcpy( &insamp[filterLength - 1], input,
            length * sizeof(double) );

    // apply the filter to each input sample
    for ( n = 0; n < length; n++ ) {
        // calculate output n
        coeffp = coeffs;
        inputp = &insamp[filterLength - 1 + n];
        acc = 0;
        for ( k = 0; k < filterLength; k++ ) {
            acc += (*coeffp++) * (*inputp--);
        }
        output[n] = acc;
    }
    // shift input samples back in time for next time
    memmove( &insamp[0], &insamp[length],
            (filterLength - 1) * sizeof(double) );
}

*/

const float firCoeffs32[NUM_TAPS]= {
		   -0.00653603984882394470,
		        -0.01027017922497046100,
		        -0.01384196957956241500,
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		        -0.00653603984882394470,
		        -0.00321978326912657950
};

